## boards/carrefinho/transporter/Kconfig.defconfig
```kconfig
# Copyright (c) 2026 carrefinho
# SPDX-License-Identifier: MIT

if BOARD_TRANSPORTER_CH32X035_ZMK

config ZMK_KEYBOARD_NAME
	default "Transporter"

endif # BOARD_TRANSPORTER_CH32X035_ZMK
```

## boards/carrefinho/transporter/Kconfig.transporter
```kconfig
# Copyright (c) 2026 carrefinho
# SPDX-License-Identifier: MIT

config BOARD_TRANSPORTER
	select SOC_CH32X035
	select ZMK_BOARD_COMPAT if BOARD_TRANSPORTER_CH32X035_ZMK
```

## boards/carrefinho/transporter/board.yml
```yaml
board:
  name: transporter
  full_name: Transporter
  vendor: carrefinho
  socs:
    - name: ch32x035
      variants:
        - name: zmk
```
